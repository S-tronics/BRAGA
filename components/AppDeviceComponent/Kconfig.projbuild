## components/AppDeviceComponent/Kconfig.projbuild
```kconfig
menu "App Device settings"
	config BRAGA_GPIO_RED
        int "GPIO for led red"
        range 0 34 if IDF_TARGET_ESP32
        range 0 46 if IDF_TARGET_ESP32S2
        range 0 48 if IDF_TARGET_ESP32S3
        range 0 19 if IDF_TARGET_ESP32C3
        default 7
        help
            GPIO number for BRAGA Red Led
    config BRAGA_GPIO_GREEN
        int "GPIO for led green"
        range 0 34 if IDF_TARGET_ESP32
        range 0 46 if IDF_TARGET_ESP32S2
        range 0 48 if IDF_TARGET_ESP32S3
        range 0 19 if IDF_TARGET_ESP32C3
        default 15
        help
            GPIO number for BRAGA Green Led
    config BRAGA_GPIO_BLUE
        int "GPIO for led blue"
        range 0 34 if IDF_TARGET_ESP32
        range 0 46 if IDF_TARGET_ESP32S2
        range 0 48 if IDF_TARGET_ESP32S3
        range 0 19 if IDF_TARGET_ESP32C3
        default 6
    help
            GPIO number for BRAGA Blue Led      
endmenu
```

## components/AppDiagnosticsComponent/Kconfig.projbuild
```kconfig
menu "App Diagnostics settings"
    config KEEP_ALIVE_INTERVAL_MINUTES
        int "Keep alive MQTT interval in minutes"
        default 1
        help
            Amount of minutes between a MQTT keep alive message.
    config LOGGING_INTERVAL_MINUTES
        int "Logging MQTT interval in minutes"
        default 10
        help
            Amount of minutes between a MQTT logging message.
    config MEAS_INTERVAL_SECONDS
        int "Measurement interval in seconds"
        default 1
        help
            Amount of seconds current en voltage of RS485-bus is measured
    config PRINT_ERROR_MESSAGE
        bool "Print error messages in terminal: handy for debugging"
        default y
        help
            This allows you to print or skip error message printing in terminal.
    config CURRENT_UPPER_LIMIT
        int "upperlimit of current towards RS485-bus in tousands of an Amp (mA)"
        default 3000
        help
            upperlimit of the current
    config CURRENT_LOWER_LIMIT
        int "lowerlimit of current towards RS485-bus in tousands of an Amp (mA)"
        default 100
        help
            lowerlimit of the current
    config VOLTAGE_UPPER_LIMIT
        int "upperlimit of voltage on RS485-bus in tousands of a V (mV)"
        default 12500
        help
            upperlimit of the voltage
    config VOLTAGE_LOWER_LIMIT
        int "lowerlimit of voltage on RS485-bus in tousands of a V (mV)"
        default 9000
        help
            lowerlimit of the voltage    
endmenu
```

## components/AppMQTTComponent/Kconfig.projbuild
```kconfig
menu "App MQTT Config"
    config BROKER_URL
        string "Broker URL"
        default "mqtt://ecec22b4c20f44b0b02f4011523b1c1c.s1.eu.hivemq.cloud"
        help
            URL of the broker to connect to
    
    config CONFIG_TOPIC
        string "Config Topic"
        default "BRAGA/CONFIG"
        help
            Config topic, used for configuring the stairs "/*MAC-ADRESS*" will be appended to the topic.

    config CONTROL_TOPIC
        string "Control Topic"
        default "BRAGA/CONTROL"
        help
            Control topic, used for directing the stairs. "/*MAC-ADRESS*" will be appended to the topic.

    config LOGGING_TOPIC
        string "Logging Topic"
        default "BRAGA/LOGGING"
        help
            Logging topic, used for diagnostic purposes. "/*MAC-ADRESS*" will be appended to the topic. 

    config ERROR_TOPIC
        string "Error Topic"
        default "BRAGA/ERROR"
        help
            Error topic, used for critical diagnostic messages. "/*MAC-ADRESS*" will be appended to the topic. 
    
    config OTA_TOPIC
        string "Over The Air Topic"
        default "BRAGA/OTA"
        help
            OTA topic, used letting the ESP32s3 know the .bin URL. "/*MAC-ADRESS*" will be appended to the topic.

    config DIAGNOSTICS_TOPIC
        string "Diagnostics Topic"
        default "BRAGA/DIAGNOSTICS"
        help
            Diagnostics topic, used for keep-alive and logging. "/*MAC-ADRESS*" will be appended to the topic.

    config SETUP_TOPIC
        string "Setup Topic"
        default "BRAGA/SETUP"
        help
            Setup topic, used for initialization of stairs. "/*MAC-ADRESS*" will be appended to the topic.
endmenu
```

## components/DrvI2CComponent/Kconfig.projbuild
```kconfig
menu "DRV I2C-communication Settings"
    config BRAGA_I2C_MASTER_SCL
        int "SCL of I2C-communication"
        range 0 34 if IDF_TARGET_ESP32
        range 0 46 if IDF_TARGET_ESP32S2
        range 0 48 if IDF_TARGET_ESP32S3
        range 0 19 if IDF_TARGET_ESP32C3
        default 9
        help
            SCL of I2C-communication
    config BRAGA_I2C_MASTER_SDA
        int "SDA of I2C-communication"
        range 0 34 if IDF_TARGET_ESP32
        range 0 46 if IDF_TARGET_ESP32S2
        range 0 48 if IDF_TARGET_ESP32S3
        range 0 19 if IDF_TARGET_ESP32C3
        default 10
        help
            SDA of I2C-communication
endmenu
```

## main/Kconfig.projbuild
```kconfig
menu "App main config settings"
    config MAX_NBR_STAIRS
        int "Maxiumum number of stairs"
        default 30
        help
            The maximum numbers of stairs per driver (ESP32)
    
    config SOFTWARE_VERSION
        string "Software version"
        default "0.0.2"
        help
            The software version of the driver
    
    config HARDWARE_VERSION
        string "Hardware version"
        default "0.0.1"
        help
            The hardware version of the driver

    config EXAMPLE_SKIP_COMMON_NAME_CHECK
        bool "Skip server certificate CN fieldcheck"
        default n
        help
            This allows you to skip the validation of OTA server certificate CN field.

    config EXAMPLE_SKIP_VERSION_CHECK
        bool "Skip firmware version check"
        default n
        help
            This allows you to skip the firmware version check.

    config EXAMPLE_OTA_RECV_TIMEOUT
        int "OTA Receive Timeout"
        default 5000
        help
            Maximum time for reception

    config EXAMPLE_ENABLE_PARTIAL_HTTP_DOWNLOAD
        bool "Enable partial HTTP download"
        default n
        help
            This enables use of Range header in esp_https_ota component.
            Firmware image will be downloaded over multiple HTTP requests.

    config EXAMPLE_HTTP_REQUEST_SIZE
        int "HTTP request size"
        default MBEDTLS_SSL_IN_CONTENT_LEN
        depends on EXAMPLE_ENABLE_PARTIAL_HTTP_DOWNLOAD
        help
            This options specifies HTTP request size. Number of bytes specified
            in this option will be downloaded in single HTTP request.
endmenu
```
